## esp32_idf_s3n16r8/main/Kconfig.projbuild
```kconfig
menu "Minibox"

config MINIBOX_HARDWARE_TEST
    bool "Boot the original hardware diagnostics instead of the LVGL apps"
    default n
    help
        Run the original screen, keys, joystick, PCF8563 and microphone test.
        Leave disabled for chat, radio, settings and games.

config MINIBOX_BUTTON_ACTIVE_LOW
    bool "GPIO4/5/6/7 buttons pressed at low level (internal pull-ups)"
    default y
    help
        Direct-solder mechanical switches require this option enabled.
        Each switch shorts its GPIO to common ground when pressed.
        Disable for modules that output a high level when pressed.

config MINIBOX_RADIO_TEST
    bool "Speaker test: play Donggan 101 instead of microphone recording"
    default n
    help
        Connect to the configured Wi-Fi and continuously play Donggan 101.
        Microphone recording is disabled to avoid sharing the I2S clocks.
        Buttons, joystick, RTC and display remain active.

config MINIBOX_WIFI_SSID
    string "Radio Wi-Fi SSID"
    default "MiaoHome"

config MINIBOX_WIFI_PASSWORD
    string "Radio Wi-Fi password (local sdkconfig only)"
    default ""
    help
        Set locally with menuconfig. Never put credentials in sdkconfig.defaults.

config MINIBOX_JOYSTICK_X_PIN
    int "Joystick VRx GPIO (ADC1)"
    range 1 2
    default 1

config MINIBOX_JOYSTICK_Y_PIN
    int "Joystick VRy GPIO (ADC1)"
    range 1 2
    default 2

config MINIBOX_JOYSTICK_X_INVERTED
    bool "Invert joystick X"
    default y

config MINIBOX_JOYSTICK_Y_INVERTED
    bool "Invert joystick Y"
    default n

config MINIBOX_AMP_GAIN_12DB
    bool "MAX98357 GAIN: drive GPIO42 low for 12 dB (off = floating, 9 dB)"
    default n
    help
        GPIO42 controls amplifier gain, not the unused joystick switch.
        Enable to drive GAIN low for approximately 12 dB.
        Disable to leave GAIN high-impedance without pull-ups or pull-downs
        for approximately 9 dB. SD/MODE remains on GPIO47.

config MINIBOX_LCD_SPI_MHZ
    int "ST7796 SPI clock (MHz)"
    range 1 40
    default 40

config MINIBOX_LCD_BGR
    bool "ST7796 BGR color order"
    default y

config MINIBOX_LCD_INVERTED
    bool "ST7796 display inversion"
    default n

config MINIBOX_LCD_BACKLIGHT_ACTIVE_LOW
    bool "Backlight active low"
    default n

config MINIBOX_LCD_STATIC_TEST
    bool "Diagnostic: freeze display after first joystick frame"
    default n
    help
        Stop all screen writes after the first test frame.
        Joystick sampling and serial logs continue. Use this to distinguish
        SPI refresh artifacts from whole-panel/backlight fluctuations.

endmenu
```

## esp32_idf_s3n16r8/sdkconfig.defaults
```kconfig
CONFIG_IDF_TARGET="esp32s3"
CONFIG_ESPTOOLPY_FLASHMODE_DIO=y
CONFIG_ESPTOOLPY_FLASHFREQ_80M=y
CONFIG_ESPTOOLPY_FLASHSIZE_16MB=y
CONFIG_PARTITION_TABLE_CUSTOM=y
CONFIG_PARTITION_TABLE_CUSTOM_FILENAME="partitions.csv"
CONFIG_SPIRAM=y
CONFIG_SPIRAM_MODE_OCT=y
CONFIG_SPIRAM_SPEED_40M=y
CONFIG_SPIRAM_USE_MALLOC=y
CONFIG_SPIRAM_MALLOC_RESERVE_INTERNAL=32768
CONFIG_ESP_CONSOLE_UART_DEFAULT=y
CONFIG_ESP_MAIN_TASK_STACK_SIZE=6144
CONFIG_FREERTOS_HZ=1000
CONFIG_COMPILER_OPTIMIZATION_SIZE=y
CONFIG_MBEDTLS_CERTIFICATE_BUNDLE=y
CONFIG_MINIBOX_JOYSTICK_X_PIN=1
CONFIG_MINIBOX_JOYSTICK_Y_PIN=2
CONFIG_HTTPD_MAX_REQ_HDR_LEN=2048
CONFIG_SPIFFS_MAX_PARTITIONS=2
CONFIG_ESP_MAIN_TASK_AFFINITY_CPU0=y
CONFIG_ESP_WIFI_TASK_PINNED_TO_CORE_0=y
CONFIG_LWIP_TCPIP_TASK_AFFINITY_CPU0=y
CONFIG_MBEDTLS_DYNAMIC_BUFFER=y
CONFIG_MBEDTLS_ASYMMETRIC_CONTENT_LEN=y
CONFIG_MBEDTLS_SSL_IN_CONTENT_LEN=16384
CONFIG_MBEDTLS_SSL_OUT_CONTENT_LEN=4096
CONFIG_LV_COLOR_DEPTH_16=y
CONFIG_LV_MEM_CUSTOM=y
CONFIG_MBEDTLS_DEFAULT_MEM_ALLOC=y
CONFIG_ESP_WIFI_STATIC_RX_BUFFER_NUM=6
CONFIG_ESP_WIFI_DYNAMIC_RX_BUFFER_NUM=16
CONFIG_ESP_WIFI_DYNAMIC_TX_BUFFER_NUM=16
```
